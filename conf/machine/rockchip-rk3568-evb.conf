## conf/machine/rockchip-rk3568-evb.conf
```bitbake
# Copyright (c) 2020, Rockchip Electronics Co., Ltd
# Released under the MIT license (see COPYING.MIT for the terms)

#@TYPE: Machine
#@NAME: RK3568 EVB

require conf/machine/rockchip-rk3566-evb.conf

KERNEL_DEVICETREE = "rockchip/rk3568-evb1-ddr4-v10-linux.dtb"
IMAGE_INSTALL += "kernel-modules"

IMAGE_INSTALL += "apt "
IMAGE_INSTALL += "usbutils"
IMAGE_INSTALL:append = " \
	iw wpa-supplicant bluez5 \
	${MACHINE_EXTRA_RRECOMMENDS} \
"
MACHINE_EXTRA_RRECOMMENDS:append = " \
	rkwifibt-firmware \
	kernel-modules \
"
IMAGE_INSTALL:append = " udev-conf-rockchip os-release ifupdown dhcpcd" 

IMAGE_INSTALL:append = " alsa-utils rockchip-alsa-config pulseaudio-server alsa-plugins-pulseaudio-conf"
IMAGE_INSTALL:append = " gstreamer1.0 gstreamer1.0-plugins-base gstreamer1.0-plugins-bad gstreamer1.0-plugins-good gstreamer1.0-rockchip"
RK_OVERLAY_DIRS:append = " \
        ${TOPDIR}/../meta-rockchip/bt \
"
# For adb
IMAGE_INSTALL:append = " android-tools-adbd"
PREFERRED_PROVIDER_android-tools-conf = "android-tools-conf-rockchip"
USB_DEBUGGING_ENABLED = "1"

DISPLAY_PLATFORM ?= "wayland"

DISTRO_FEATURES:append = " ${@d.getVar('DISPLAY_PLATFORM')}"
DISTRO_FEATURES:remove = " ${@'x11' if d.getVar('DISPLAY_PLATFORM') == 'wayland' else 'wayland'}"
IMAGE_FEATURES:append = " ${@'x11-base' if d.getVar('DISPLAY_PLATFORM') == 'x11' else ''}"
IMAGE_INSTALL:append = " ${@'weston weston-init weston-examples' if d.getVar('DISPLAY_PLATFORM') == 'wayland' else 'xf86-video-modesetting xserver-xorg-module-exa'}"

# For mali gpu
DISTRO_FEATURES:append = " egl"

# For glmark2
DISTRO_FEATURES:append = " opengl"
IMAGE_INSTALL:append = " glmark2"
PACKAGECONFIG:pn-glmark2 = \
         "${@bb.utils.contains('DISTRO_FEATURES', 'x11 opengl', 'x11-gles2', '', d)} \
          ${@bb.utils.contains('DISTRO_FEATURES', 'wayland opengl', 'wayland-gles2', '', d)} \
          drm-gles2"
```
